## src/meta-tgbs-demo/conf/layer.conf
```bitbake
BBPATH .= ":${LAYERDIR}"

BBFILES += "${LAYERDIR}/recipes-*/*/*.bb \
            ${LAYERDIR}/recipes-*/*/*.bbappend"

BBFILE_COLLECTIONS += "meta-tgbs-demo"
BBFILE_PATTERN_meta-tgbs-demo = "^${LAYERDIR}/"
BBFILE_PRIORITY_meta-tgbs-demo = "7"

LAYERDEPENDS_meta-tgbs-demo = "core openembedded-layer meta-tgbs meta-kdebug"
LAYERSERIES_COMPAT_meta-tgbs-demo = "scarthgap"
```

## src/meta-tgbs/conf/layer.conf
```bitbake
BBPATH .= ":${LAYERDIR}"

BBFILES += "${LAYERDIR}/recipes-*/*/*.bb ${LAYERDIR}/recipes-*/*/*.bbappend"

BBFILE_COLLECTIONS += "meta-tgbs"
BBFILE_PATTERN_meta-tgbs = "^${LAYERDIR}/"
BBFILE_PRIORITY_meta-tgbs = "6"

LAYERSERIES_CORENAMES = "scarthgap"
LAYERSERIES_COMPAT_meta-tgbs = "scarthgap"
LAYERDEPENDS_meta-tgbs = "core"
```

## src/meta-tgbs/conf/machine/qemuarm32.conf
```bitbake
#@TYPE: Machine
#@NAME: QEMU ARM 32-bit
#@DESCRIPTION: ARMv7 QEMU virt machine matching the Zybo Z7 Cortex-A9 SoC

require conf/machine/include/arm/armv7a/tune-cortexa9.inc
require conf/machine/include/qemu.inc

PREFERRED_PROVIDER_virtual/kernel = "linux-tgbs"

KERNEL_IMAGETYPE = "zImage"
SERIAL_CONSOLES = "115200;ttyAMA0"

QB_SYSTEM_NAME = "qemu-system-arm"
QB_MACHINE = "-machine virt,highmem=off"
# QEMU virt does not support Cortex-A9; A15 runs the Cortex-A9-tuned ARMv7 binaries.
QB_CPU = "-cpu cortex-a15"
QB_SMP ?= "-smp 2"
QB_MEM ?= "-m 1024"

QB_TAP_OPT = "-netdev tap,id=net0,ifname=@TAP@,script=no,downscript=no"
QB_NETWORK_DEVICE = "-device virtio-net-device,netdev=net0,mac=@MAC@"
QB_ROOTFS_OPT = "-drive id=disk0,file=@ROOTFS@,if=none,format=raw -device virtio-blk-device,drive=disk0"
QB_SERIAL_OPT = "-device virtio-serial-device -chardev null,id=virtcon -device virtconsole,chardev=virtcon"
QB_TCPSERIAL_OPT = "-device virtio-serial-device -chardev socket,id=virtcon,port=@PORT@,host=127.0.0.1,nodelay=on -device virtconsole,chardev=virtcon"
```

## src/meta-tgbs/conf/machine/zybo-z7.conf
```bitbake
#@TYPE: Machine
#@NAME: Digilent Zybo Z7
#@DESCRIPTION: Digilent Zybo Z7 (Zynq-7000 Cortex-A9) machine for TGBS

require conf/machine/include/arm/armv7a/tune-cortexa9.inc

PREFERRED_PROVIDER_virtual/kernel = "linux-tgbs"
PREFERRED_PROVIDER_virtual/bootloader = "u-boot"

KERNEL_IMAGETYPE = "zImage"
KERNEL_DEVICETREE = "xilinx/zynq-zybo-z7.dtb"

UBOOT_MACHINE = "xilinx_zynq_virt_defconfig"
UBOOT_SUFFIX = "img"
UBOOT_ENTRYPOINT = "0x00008000"
UBOOT_LOADADDRESS = "0x00008000"
SPL_BINARY = "spl/boot.bin"

UBOOT_EXTLINUX = "1"
UBOOT_EXTLINUX_ROOT = "root=/dev/mmcblk0p2"
UBOOT_EXTLINUX_KERNEL_IMAGE = "/zImage"
UBOOT_EXTLINUX_FDT = "/system.dtb"
UBOOT_EXTLINUX_CONSOLE = "console=ttyPS0,115200"

SERIAL_CONSOLES = "115200;ttyPS0"

MACHINE_FEATURES = "kernel26 usbhost vfat ext2 ethernet"
EXTRA_IMAGEDEPENDS += "u-boot"

IMAGE_FSTYPES += "wic wic.bmap"
WKS_FILE = "zybo-z7.wks"
IMAGE_BOOT_FILES = " \
    boot.bin \
    u-boot.img \
    zImage \
    zynq-zybo-z7.dtb;system.dtb \
    extlinux.conf;extlinux/extlinux.conf \
"
```
